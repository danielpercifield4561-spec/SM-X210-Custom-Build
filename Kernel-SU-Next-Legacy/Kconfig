## Kernel-SU-Next-Legacy/Kconfig
```kconfig
menu "KernelSU"

config KSU
	bool "KernelSU function support"
	default y
	help
	  Enable kernel-level root privileges on Android System.
	  This is the main toggle for the KernelSU-Next-Legacy features.

config KSU_DEBUG
	bool "KernelSU debug mode"
	depends on KSU
	default n
	help
	  Enable this if you want to see detailed KernelSU logs in dmesg.

config KSU_MANUAL_HOOK
	bool "KernelSU manual hook mode"
	depends on KSU
	default y
	help
	  Since you are manually patching fs/open.c and other files, 
	  this MUST be set to Y. It tells KernelSU to use your 
	  hand-placed hooks.

config KSU_KPROBES_HOOK
	bool "KernelSU Kprobes hook"
	depends on KSU && !KSU_MANUAL_HOOK
	default n
	help
	  Disable this. We are using Manual Hooks to bypass Samsung's 
	  security layers more effectively.

endmenu
```
